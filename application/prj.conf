## west.yml
```
manifest:
  # This west.yml requires west 0.12s or later, because the "import"
  # feature used below was introduced then.
  version: 0.12

  # "projects" is a list of git repositories which make up the project
  projects:
    - name: zephyr
      url: https://github.com/zephyrproject-rtos/zephyr.git
      revision: v3.7.0 # LTS3 (see https://docs.zephyrproject.org/latest/releases/index.html)
      import:
        name-allowlist: # select what we need
          - cmsis
          - hal_stm32
          - mcuboot
          - segger
          - zephyr
    - name: cmsis-svd-data
      url: https://github.com/cmsis-svd/cmsis-svd-data.git
      path: modules/debug/cmsis-svd
      revision: main

  self:
    # This repository should be cloned to application.
    path: application
```

## prj.conf
```kconfig
CONFIG_GPIO=y

# Stacks and heaps
CONFIG_MAIN_STACK_SIZE=3072
CONFIG_HEAP_MEM_POOL_SIZE=16384

# Logging via RTT
CONFIG_LOG=y
CONFIG_LOG_MODE_IMMEDIATE=y
CONFIG_USE_SEGGER_RTT=y
CONFIG_LOG_BACKEND_RTT=y

CONFIG_NO_OPTIMIZATIONS=y

# Add information for debugging
CONFIG_DEBUG_THREAD_INFO=y
```

## src/main.c
```c
#include <device.h>
#include <devicetree.h>
#include <drivers/eeprom.h>
#include <drivers/gpio.h>
#include <drivers/sensor.h>
#include <logging/log.h>
#include <stdio.h>
#include <zephyr.h>

#include <stdio.h>

#define LED0_NODE DT_ALIAS(led0)

/*
 * A build error on this line means your board is unsupported.
 * See the sample documentation for information on how to fix this.
 */
static const struct gpio_dt_spec led = GPIO_DT_SPEC_GET(LED0_NODE, gpios);

LOG_MODULE_REGISTER(main);
/* The devicetree node identifier for the "led0" alias. */

void main(void) {
  int ret;

  if (!device_is_ready(led.port)) {
    return;
  }

  ret = gpio_pin_configure_dt(&led, GPIO_OUTPUT_LOW);
  if (ret < 0) {
    return;
  }

  while (1) {
    ret = gpio_pin_toggle_dt(&led);
    if (ret < 0) {
      return;
    }
    LOG_INF(".");
    k_msleep(500);
  }
}
```
